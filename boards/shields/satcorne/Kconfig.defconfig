## boards/shields/satcorne/Kconfig.defconfig
```kconfig
if SHIELD_SATCORNE_LEFT

config ZMK_KEYBOARD_NAME
    default "SATCorne"

config ZMK_SPLIT_ROLE_CENTRAL
    default y

endif

if SHIELD_SATCORNE_LEFT || SHIELD_SATCORNE_RIGHT

config ZMK_SPLIT
    default y

endif
```
