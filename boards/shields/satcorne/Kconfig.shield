## boards/shields/satcorne/Kconfig.shield
```kconfig
config SHIELD_SATCORNE_LEFT
    def_bool $(shields_list_contains,satcorne_left)

config SHIELD_SATCORNE_RIGHT
    def_bool $(shields_list_contains,satcorne_right)
```
