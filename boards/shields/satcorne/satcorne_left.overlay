#include "satcorne.dtsi"

&kscan0 {
    col-gpios
        = <&gpio0 10 (GPIO_ACTIVE_HIGH | GPIO_PULL_DOWN)>,
          <&gpio0 11 (GPIO_ACTIVE_HIGH | GPIO_PULL_DOWN)>,
          <&gpio0 13 (GPIO_ACTIVE_HIGH | GPIO_PULL_DOWN)>,
          <&gpio0 15 (GPIO_ACTIVE_HIGH | GPIO_PULL_DOWN)>,
          <&gpio0 2 (GPIO_ACTIVE_HIGH | GPIO_PULL_DOWN)>,
          <&gpio0 29 (GPIO_ACTIVE_HIGH | GPIO_PULL_DOWN)>,
          <&gpio0 31 (GPIO_ACTIVE_HIGH | GPIO_PULL_DOWN)>;

    row-gpios
        = <&gpio0 9 (GPIO_ACTIVE_HIGH | GPIO_PULL_DOWN)>
        ;

};
